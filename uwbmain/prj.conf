## CMakeLists.txt
```
cmake_minimum_required(VERSION 3.20.0)

set(PROJ_ROOT ${CMAKE_CURRENT_SOURCE_DIR})
set(BOARD_ROOT ${CMAKE_CURRENT_SOURCE_DIR}/..)
set(TREE_ROOT ${CMAKE_CURRENT_SOURCE_DIR}/..)
set(COMPONENTS_DIR ${TREE_ROOT}/components)
set(DRIVERS_DIR ${TREE_ROOT}/drivers)
set(APPLICATION_DIR ${PROJ_ROOT}/src)
set(BIXBY_DIR ${TREE_ROOT}/Bixby/Source)

# include our common cmake functions
include(${TREE_ROOT}/helpers.cmake)

# these 2 enable a remarkably sketchy hack that lets us mix s/w implementation
# of secpk1_256 curves while retaining h/w impl. of other curves
# (since k1 isnt handled in h/w atm)
add_compile_definitions(LEVEL_ECP_ALT_PER_CURVE)
add_compile_definitions(MBEDTLS_ECP_DP_SECP256K1_ENABLED)

list(APPEND OVERLAY_CONFIG "${PROJ_ROOT}/prj.conf")
list(APPEND OVERLAY_CONFIG "${PROJ_ROOT}/prj_${BOARD}.conf")

if(EXISTS "${PROJ_ROOT}/child_image/mcuboot/mcuboot_${BOARD}.conf")
    set(mcuboot_CONF_FILE $ENV{ZEPHYR_BASE}/../bootloader/mcuboot/boot/zephyr/prj.conf ${PROJ_ROOT}/child_image/mcuboot/mcuboot_${BOARD}.conf)
    set(mcuboot_DTC_OVERLAY_FILE ${BOARD_ROOT}/boards/${BOARD}.overlay)
endif()

set(DTC_OVERLAY_FILE ${BOARD_ROOT}/boards/${BOARD}.overlay)

list(APPEND DTS_ROOT ${TREE_ROOT})

find_package(Zephyr REQUIRED HINTS $ENV{ZEPHYR_BASE})
project(artemis_ouer)

# these two turn on assert-logging and "require" macro failure logging
# and take up a good chunk of space in code
add_compile_definitions(stargate_ftd) #  force LoggingConfig.h to use LOG_INF semantics for ncs
add_compile_definitions(INTERNAL)
add_compile_definitions(BUILT_WITH_CMAKE)

add_compile_definitions(APP_NAME_STR="nrfuwb")

set(APPLICATION_SRCS
  ${APPLICATION_DIR}/main.c
)

add_level_component(nearby_interaction)
add_level_component(uwb)
add_level_component(uci)
add_level_component(hbci)
add_level_component(nrfspi)
add_level_component(timesvc)
add_level_component(crypto)
add_level_component(ssd1306)

if(CONFIG_BT)
  add_level_component(ble)
endif()

target_sources(app PRIVATE
  ${APPLICATION_SRCS}
)

target_include_directories(app PRIVATE
  ${APPLICATION_DIR}
  ${BIXBY_DIR}/Include
)

# Wait for the MCUBoot Image to generate the public key and then pull that into parent image
#set(GENERATED_PUBKEY ${ZEPHYR_BINARY_DIR}/../mcuboot/zephyr/autogen-pubkey.c)
#add_custom_command(
#  OUTPUT ${GENERATED_PUBKEY}
#  COMMAND cat ${GENERATED_PUBKEY}
#  DEPENDS mcuboot_subimage
#)
#set_property(TARGET app APPEND PROPERTY SOURCES ${GENERATED_PUBKEY})
```

## prj.conf
```kconfig
# Common Configuration for Thread on Nordic DK boards

# Both 5340 and 52840 have h/w float
CONFIG_FPU=y

# UART
# CONFIG_UART_INTERRUPT_DRIVEN=y
CONFIG_SERIAL=y

CONFIG_GPIO=y
CONFIG_ADC=y
CONFIG_I2C=y
CONFIG_LED=y

# Level options
CONFIG_DISPLAY=y

CONFIG_SSD1306=y
CONFIG_SSD1306_DEFAULT_CONTRAST=128
CONFIG_SSD1306_DEFAULT=y

CONFIG_CHARACTER_FRAMEBUFFER=y
CONFIG_CHARACTER_FRAMEBUFFER_USE_DEFAULT_FONTS=n

# Watchdog
CONFIG_WATCHDOG=y

# BlueTooth
CONFIG_BT=y
CONFIG_BT_SETTINGS=y
CONFIG_BT_PERIPHERAL=y
CONFIG_BT_DEVICE_NAME="nrfUWB"
CONFIG_BT_DEVICE_NAME_DYNAMIC=y
CONFIG_BT_MAX_CONN=2
CONFIG_BT_SMP=y
CONFIG_BT_MAX_PAIRED=2

# Bluetooth Buffer Configuration
CONFIG_BT_BUF_ACL_RX_SIZE=251
CONFIG_BT_BUF_ACL_TX_SIZE=251
CONFIG_BT_L2CAP_TX_MTU=247
CONFIG_BT_CTLR_DATA_LENGTH_MAX=251
CONFIG_BT_L2CAP_TX_BUF_COUNT=4

# set faster connection interval (15ms in 1.25ms units)
CONFIG_BT_PERIPHERAL_PREF_MIN_INT=12
CONFIG_BT_PERIPHERAL_PREF_MAX_INT=24
CONFIG_BT_PERIPHERAL_PREF_LATENCY=1
CONFIG_BT_PERIPHERAL_PREF_TIMEOUT=100

CONFIG_LOG=y
CONFIG_LOG_PRINTK=n
CONFIG_LOG_MODE_MINIMAL=n
CONFIG_LOG_MODE_DEFERRED=y

CONFIG_LOG_BUFFER_SIZE=65536

# Optional loggig via UART
CONFIG_LOG_BACKEND_UART_AUTOSTART=y
CONFIG_LOG_BACKEND_UART=y

# Enable shell with root commands. Override the
# default shell thread priority to ensure that
# it is above that of the logging thread.
CONFIG_SHELL_THREAD_PRIORITY_OVERRIDE=y
CONFIG_SHELL_THREAD_PRIORITY=12
CONFIG_SHELL_CMDS_SELECT=y
CONFIG_SHELL_LOG_BACKEND=n
CONFIG_SHELL_AUTOSTART=y
#CONFIG_SHELL_MINIMAL=y
CONFIG_SHELL=y


# Thread analysis - uncomment this to get info on stack use, etc
#CONFIG_THREAD_NAME=y
#CONFIG_THREAD_ANALYZER=y
#CONFIG_THREAD_ANALYZER_AUTO=y
#CONFIG_THREAD_ANALYZER_RUN./_UNLOCKED=y
#CONFIG_THREAD_ANALYZER_USE_PRINTK=y

# Include settings
CONFIG_FLASH=y
CONFIG_FLASH_PAGE_LAYOUT=y
CONFIG_FLASH_MAP=y
CONFIG_NVS=y
CONFIG_SETTINGS=y

# Hardware Info Support
CONFIG_HWINFO=y
CONFIG_HWINFO_NRF=y

# use cacheing for nvs
CONFIG_NVS_LOOKUP_CACHE=y

# Generic networking options
CONFIG_NETWORKING=y

CONFIG_ASSERT=y
CONFIG_ASSERT_NO_COND_INFO=y

# Spi
CONFIG_SPI=y
CONFIG_SPI_NRFX=y
# using SPI1 as master
CONFIG_NRFX_SPI1=y
CONFIG_NRFX_SPIM1=y

CONFIG_MAIN_STACK_SIZE=6500

# Use mbedtls s/w crypto since nordics psa doesnt support
# things like key deriviation
#
CONFIG_NRF_SECURITY=y
CONFIG_MBEDTLS_LEGACY_CRYPTO_C=y
CONFIG_MBEDTLS_USE_PSA_CRYPTO=y
CONFIG_MBEDTLS_PSA_CRYPTO_C=y
CONFIG_PSA_CRYPTO_DRIVER_OBERON=y
CONFIG_OBERON_BACKEND=y
CONFIG_MBEDTLS_ENABLE_HEAP=y
CONFIG_MBEDTLS_HEAP_SIZE=8192
CONFIG_MBEDTLS_PK_WRITE_C=y
CONFIG_MBEDTLS_AES_C=y
CONFIG_MBEDTLS_CIPHER_MODE_CBC=y
CONFIG_MBEDTLS_ECP_C=y
CONFIG_MBEDTLS_GCM_C=y
CONFIG_MBEDTLS_CHACHA20_C=y
CONFIG_MBEDTLS_CTR_DRBG_C=y
```

## prj_nrf5340dk_nrf5340_cpuapp.conf
```kconfig
# Configuration specific for inner proto1

# using SPI0 as master
CONFIG_NRFX_SPIM0=y

# External QSPI Flash
CONFIG_NORDIC_QSPI_NOR=y
CONFIG_NORDIC_QSPI_NOR_FLASH_LAYOUT_PAGE_SIZE=4096
CONFIG_NORDIC_QSPI_NOR_STACK_WRITE_BUFFER_SIZE=16
```

## src/main.c
```c
#include <zephyr/kernel.h>
#include <zephyr/device.h>

#define COMPONENT_NAME uwbmain
#include "Logging.h"

#if CONFIG_BT
    #include "level_ble.h"
#endif
#include "nearby_interaction.h"
#include "uwb.h"
#include "timesvc.h"
#include "crypto_platform.h"
#ifdef CONFIG_SSD1306
#include "display.h"
#endif

int main( void )
{
    int ret;

    LOG_INF("NRF UWB Device");

    uint32_t delay = 2000;
    uint32_t min_delay;

    ret = CryptoPlatformInit();
    require_noerr(ret, exit);

    ret = TimeInit();
    require_noerr(ret, exit);

    ret = NIinit();
    require_noerr(ret, exit);

    #ifdef CONFIG_SSD1306
    ret = DisplayInit();
    require_noerr(ret, exit);

    DisplaySetFont(8);
    DisplayText(34, 0, "-- Level --");
    DisplaySetFont(20);
    DisplayText(44, 12, "UWB");
    #endif
    #if CONFIG_BT
    ret = BLEinit(CONFIG_BT_DEVICE_NAME, NIbleConnectHandler);
    require_noerr(ret, exit);
    #endif

    // Run the application
    //
    while (true)
    {
        delay = 200;
        min_delay = delay;

        ret = NIslice(&delay);
        if (delay < min_delay)
        {
            min_delay = delay;
        }

        #if CONFIG_BT
        ret = BLEslice(&delay);
        if (delay < min_delay)
        {
            min_delay = delay;
        }
        #endif

        // sleep for up-to min_delay.  Any events that need attention
        // will call TimeSignalApplicationEvent causing this function
        // to return immediately
        //
        TimeWaitApplicationEvent(min_delay);
    }

exit:
    return ret;
}

void Logging_CallAssertionHandlerLite(
        const char *    functionName,
        long            lineNumber,
        long            errorCode )
{
    LOG_ERR("Assert %s:%ld  %ld", functionName, lineNumber, errorCode);
}

void Logging_DebugAssert(
        const char *    componentNameString,
        const char *    assertionString,
        const char *    exceptionLabelString,
        const char *    errorString,
        const char *    fileName,
        const char *    functionName,
        long            lineNumber,
        long            errorCode )
{
    LOG_ERR("Assert %s %s:%ld  %ld", functionName, fileName, lineNumber, errorCode);
}
```
